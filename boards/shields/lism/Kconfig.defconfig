## boards/shields/lism/Kconfig.defconfig
```kconfig
if SHIELD_LISM_L

config ZMK_KEYBOARD_NAME
    default "LisM"

endif

if SHIELD_LISM_R

config ZMK_KEYBOARD_NAME
    default "LisM"

config ZMK_SPLIT_ROLE_CENTRAL
    default y

config ZMK_POINTING
    default y

config ZMK_MOUSE
    default y

config PAW3222
    default y

endif
```
