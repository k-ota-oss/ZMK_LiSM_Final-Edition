&spi0 {
    status = "okay";

    trackball_central: trackball@0 {
        status = "okay";
        compatible = "pixart,paw3222";
        reg = <0>;
        spi-max-frequency = <2000000>;
        irq-gpios = <&xiao_d 6 (GPIO_ACTIVE_LOW | GPIO_PULL_UP)>;
    };
};

&trackball_split {
    status = "disabled";
};

&central_listener {
    status = "okay";
    device = <&trackball_central>;
};
